## conf/layer.conf
```bitbake
BBPATH .= ":${LAYERDIR}"

BBFILES += "${LAYERDIR}/recipes-*/*/*.bb \
            ${LAYERDIR}/recipes-*/*/*.bbappend"

BBFILE_COLLECTIONS += "meta-aic8800"
BBFILE_PATTERN_meta-aic8800 = "^${LAYERDIR}/"
BBFILE_PRIORITY_meta-aic8800 = "6"

LAYERDEPENDS_meta-aic8800= "core"
LAYERSERIES_COMPAT_meta-aic8800 = "scarthgap"
```
